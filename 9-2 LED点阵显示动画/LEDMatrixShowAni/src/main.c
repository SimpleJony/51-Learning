#include <Atmel/REGX52.H>
#include "include/Delay.h"
#include "include/LEDMatrix.h"
#include "include/Timer0.h"

unsigned char offset=0;
unsigned char code Animation[] = { //把数组数据放入Flash,但是数组不可更改
    0x00,0x00,0x00,0x00,0x00,0x00,0x00,0x00,
    0xFF,0x08,0x08,0x08,0xFF,0x00,0x0E,0x15,
    0x15,0x15,0x08,0x00,0x7E,0x01,0x02,0x00,
    0x7E,0x01,0x02,0x00,0x0E,0x11,0x11,0x0E,
    0x00,0x3D,0x00,0x00,0x00,0x00,0x00,0x00,
    0x00,0x00,0x00,0x00,0x00,0x00,0x00,0x00,
};

void main()
{
    unsigned char i;
    Timer0_Init();
    LEDMatrix_Init();
    while(1)
    {
        for (i=0;i<8;i++){
            LEDMatrix_ShowColumn(i,Animation[i+offset]);
        }
    }
}

void Timer0_Routine() interrupt 1
{
    static unsigned int T0Count;
	TL0 = 0x18;
	TH0 = 0xFC;
    T0Count++;
    if (T0Count >= 100){ // 1ms * 1000 = 1s
        T0Count = 0;
        offset++;
        if (offset > 40) offset = 0;
    }
}